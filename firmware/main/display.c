#include "display.h"
#include "driver/i2c_master.h"
#include "driver/gpio.h"
#include "esp_log.h"
#include "freertos/FreeRTOS.h"
#include "freertos/task.h"
#include <string.h>
#include <stdio.h>

/* Heltec WiFi LoRa 32 V4 pin definitions */
#define OLED_SDA   17
#define OLED_SCL   18
#define OLED_RST   21
#define OLED_VEXT  36
#define OLED_ADDR  0x3C

#define OLED_W     128
#define OLED_PAGES 8

static const char *TAG = "display";

static i2c_master_bus_handle_t i2c_bus;
static i2c_master_dev_handle_t oled_dev;
static uint8_t fb[OLED_W * OLED_PAGES];

/* 5×7 ASCII font (0x20–0x7E) */
static const uint8_t FONT[][5] = {
    {0x00,0x00,0x00,0x00,0x00}, /* ' '  */
    {0x00,0x00,0x5F,0x00,0x00}, /* '!'  */
    {0x00,0x07,0x00,0x07,0x00}, /* '"'  */
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    {0x10,0x08,0x08,0x10,0x08}, /* '~'  */
};

static void fb_clear(void) { memset(fb, 0, sizeof(fb)); }

static void fb_draw_char(int col, int page, char c)
{
    if (c < 0x20 || c > 0x7E) c = '?';
    const uint8_t *g = FONT[(uint8_t)c - 0x20];
    int base = page * OLED_W + col;
    for (int i = 0; i < 5 && col + i < OLED_W; i++)
        fb[base + i] = g[i];
    if (col + 5 < OLED_W)
        fb[base + 5] = 0x00;
}

static void fb_draw_str(int col, int page, const char *s)
{
    while (*s && col + 6 <= OLED_W) {
        fb_draw_char(col, page, *s++);
        col += 6;
    }
}

static void oled_send(const uint8_t *buf, size_t len)
{
    i2c_master_transmit(oled_dev, buf, len, 500);
}

static void oled_cmd(uint8_t cmd)
{
    uint8_t buf[2] = {0x00, cmd};
    oled_send(buf, 2);
}

static void oled_flush(void)
{
    static const uint8_t addr[] = {
        0x00, 0x21, 0x00, 0x7F, 0x22, 0x00, 0x07
    };
    oled_send(addr, sizeof(addr));

    uint8_t row[OLED_W + 1];
    row[0] = 0x40;
    for (int p = 0; p < OLED_PAGES; p++) {
        memcpy(row + 1, &fb[p * OLED_W], OLED_W);
        oled_send(row, sizeof(row));
    }
}

void display_init(void)
{
    gpio_config_t io = {
        .pin_bit_mask = (1ULL << OLED_VEXT) | (1ULL << OLED_RST),
        .mode         = GPIO_MODE_OUTPUT,
    };
    gpio_config(&io);
    gpio_set_level(OLED_VEXT, 0);

    gpio_set_level(OLED_RST, 1);
    vTaskDelay(pdMS_TO_TICKS(10));
    gpio_set_level(OLED_RST, 0);
    vTaskDelay(pdMS_TO_TICKS(10));
    gpio_set_level(OLED_RST, 1);
    vTaskDelay(pdMS_TO_TICKS(10));

    i2c_master_bus_config_t bus_cfg = {
        .i2c_port                   = I2C_NUM_0,
        .sda_io_num                 = OLED_SDA,
        .scl_io_num                 = OLED_SCL,
        .clk_source                 = I2C_CLK_SRC_DEFAULT,
        .glitch_ignore_cnt          = 7,
        .flags.enable_internal_pullup = true,
    };
    ESP_ERROR_CHECK(i2c_new_master_bus(&bus_cfg, &i2c_bus));

    i2c_device_config_t dev_cfg = {
        .dev_addr_length = I2C_ADDR_BIT_LEN_7,
        .device_address  = OLED_ADDR,
        .scl_speed_hz    = 400000,
    };
    ESP_ERROR_CHECK(i2c_master_bus_add_device(i2c_bus, &dev_cfg, &oled_dev));

    oled_cmd(0xAE);
    oled_cmd(0xD5); oled_cmd(0x80);
    oled_cmd(0xA8); oled_cmd(0x3F);
    oled_cmd(0xD3); oled_cmd(0x00);
    oled_cmd(0x40);
    oled_cmd(0x8D); oled_cmd(0x14);
    oled_cmd(0x20); oled_cmd(0x00);
    oled_cmd(0xA1);
    oled_cmd(0xC8);
    oled_cmd(0xDA); oled_cmd(0x12);
    oled_cmd(0x81); oled_cmd(0xCF);
    oled_cmd(0xD9); oled_cmd(0xF1);
    oled_cmd(0xDB); oled_cmd(0x40);
    oled_cmd(0xA4);
    oled_cmd(0xA6);
    oled_cmd(0xAF);

    fb_clear();
    fb_draw_str(0, 0, "cute.tech");
    fb_draw_str(0, 2, "starting up...");
    oled_flush();

    ESP_LOGI(TAG, "OLED ready");
}

void display_show_no_config(void)
{
    fb_clear();
    fb_draw_str(0, 0, "cute.tech");
    fb_draw_str(0, 2, "no config found!");
    fb_draw_str(0, 4, "visit cute.tech");
    fb_draw_str(0, 5, "/flash to setup");
    oled_flush();
}

void display_show_connecting(const char *ssid)
{
    char line[22];
    fb_clear();
    fb_draw_str(0, 0, "cute.tech");
    fb_draw_str(0, 2, "connecting...");
    snprintf(line, sizeof(line), "%.20s", ssid);
    fb_draw_str(0, 3, line);
    oled_flush();
}

void display_show_connected(const char *ip)
{
    char line[22];
    fb_clear();
    fb_draw_str(0, 0, "cute.tech");
    fb_draw_str(0, 2, "connected!");
    snprintf(line, sizeof(line), "%.20s", ip);
    fb_draw_str(0, 3, line);
    fb_draw_str(0, 5, "visit IP in browser");
    oled_flush();
}

void display_show_online(const char *name)
{
    char line[22];
    fb_clear();
    fb_draw_str(0, 0, "cute.tech");
    fb_draw_str(0, 2, "you are live!");
    /* 21 chars fit per line: short names get "name.cute.tech" on one line,
       long ones get the name and ".cute.tech" stacked. */
    if (strlen(name) <= 11) {
        snprintf(line, sizeof(line), "%s.cute.tech", name);
        fb_draw_str(0, 4, line);
    } else {
        snprintf(line, sizeof(line), "%.21s", name);
        fb_draw_str(0, 4, line);
        fb_draw_str(0, 5, "      .cute.tech");
    }
    oled_flush();
}

void display_show_disconnected(int reason)
{
    char line[22];
    fb_clear();
    fb_draw_str(0, 0, "cute.tech");
    fb_draw_str(0, 2, "disconnected");
    snprintf(line, sizeof(line), "reason: %d", reason);
    fb_draw_str(0, 3, line);
    fb_draw_str(0, 4, "retrying...");
    oled_flush();
}
